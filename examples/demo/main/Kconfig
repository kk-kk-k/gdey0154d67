## examples/demo/main/Kconfig
```kconfig
menu "GDEY0154D67 Basic example configuration"

menu "GDEY0154D67 pinout"

config EINK_BUSY
    int "Busy pin"

config EINK_RES
    int "Reset pin"
    help
        RES on the board

config EINK_DC
    int "Data/Command pin"

config EINK_CS
    int "SPI CS pin"

config EINK_SPI_SCK
    int "SPI clock pin"
    help
        SCK on board.
        Refer to the ESP32-xx datasheet, where SPI2/3 pinout is defined.

config EINK_SPI_MOSI
    int "SPI MOSI pin"
    help
        SDI on board.
        Refer to the ESP32-xx datasheet, where SPI2/3 pinout is defined.

endmenu

endmenu
```

## examples/demo/sdkconfig.defaults
```kconfig
# Disable assert evaluations when -NDEBUG is set
CONFIG_COMPILER_ASSERT_NDEBUG_EVALUATE=n

# Increase stack smashing protection
CONFIG_COMPILER_STACK_CHECK_MODE_ALL=y

# Enable the compiler static analyzer
CONFIG_COMPILER_STATIC_ANALYZER=y

# Halt on panic
CONFIG_ESP_SYSTEM_PANIC_PRINT_HALT=y

# Disable RTC
CONFIG_ESP_INT_WDT=n
CONFIG_ESP_TASK_WDT_EN=n
```

## examples/demo/sdkconfig.defaults.esp32s3
```kconfig
# GDEY0154D67 example config (ESP32-S3 specific - check SPI pins)
CONFIG_EINK_BUSY=7
CONFIG_EINK_RES=8
CONFIG_EINK_DC=9
CONFIG_EINK_CS=10
CONFIG_EINK_SPI_SCK=12
CONFIG_EINK_SPI_MOSI=11
```
